## config/boards/arm/cockpit_ble/Kconfig.defconfig
```kconfig
if BOARD_COCKPIT_BLE
config BOARD
    string
    default "cockpit_ble"

config ZMK_KEYBOARD_NAME
    string
    default "Cockpit BLE"

config USB_DEVICE_MANUFACTURER
    string
    default "ozkancelik.com"

if ZMK_DISPLAY
config I2C
    bool
    default y

config SSD1306
    bool
    default y

config SSD1306_REVERSE_MODE
    bool
    default y
endif # ZMK_DISPLAY

if LVGL
config LV_Z_VDB_SIZE
    int
    default 64

config LV_Z_DPI
    int
    default 148

config LV_Z_BITS_PER_PIXEL
    int
    default 1

choice LV_COLOR_DEPTH
    default LV_COLOR_DEPTH_1
endchoice
endif # LVGL

if USB_DEVICE_STACK
config USB_NRFX
    bool
    default y
endif # USB_DEVICE_STACK

config BT_CTLR
    bool
    default BT

config ZMK_BLE
    bool
    default y

config ZMK_USB
    bool
    default y

endif # BOARD_COCKPIT_BLE
```
